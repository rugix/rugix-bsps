## layers/common/conf/layer.conf
```bitbake
BBPATH .= ":${LAYERDIR}"

BBFILES += "${LAYERDIR}/recipes-*/*/*.bb \
            ${LAYERDIR}/recipes-*/*/*.bbappend"

BBFILE_COLLECTIONS += "meta-rugix-bsp"
BBFILE_PATTERN_meta-rugix-bsp = "^${LAYERDIR}/"
BBFILE_PRIORITY_meta-rugix-bsp = "5"

LAYERDEPENDS_meta-rugix-bsp = "core"
LAYERSERIES_COMPAT_meta-rugix-bsp = "kirkstone scarthgap"
```
